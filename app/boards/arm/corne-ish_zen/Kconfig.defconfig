## app/boards/arm/corne-ish_zen/Kconfig.defconfig
```kconfig
#
# Copyright (c) 2021 Darryl deHaan
# SPDX-License-Identifier: MIT
#

if BOARD_CORNEISH_ZEN_LEFT

	config ZMK_KEYBOARD_NAME
	default "Corne-ish Zen"

endif # BOARD_CORNEISH_ZEN_LEFT

if BOARD_CORNEISH_ZEN_RIGHT

	config ZMK_KEYBOARD_NAME
	default "Corne-ish Zen rt"

endif # BOARD_CORNEISH_ZEN_RIGHT


if BOARD_CORNEISH_ZEN_LEFT || BOARD_CORNEISH_ZEN_RIGHT

config BOARD
	default "corne-ish_zen"

config ZMK_SPLIT
	default y

config I2C
	bool
	default y

config I2C_0
    bool
    default y
    depends on I2C

menuconfig SENSOR
    bool "Sensor Drivers"

config BQ274XX
    bool "BQ274xx Fuel Gauge"
    depends on I2C && SENSOR

config SENSOR_CAN_FETCH_ALL
	bool "Can the fuel gauge fetch all channels at once"
	default y

config SPI
    bool
    default y

config BT_CTLR
	default BT

config ZMK_BLE
	default y

config ZMK_USB
	default y

if USB

config USB_NRFX
	default y

config USB_DEVICE_STACK
	default y

endif # USB

config ZMK_DISPLAY
	select LVGL_USE_CONT
	select LVGL_FONT_MONTSERRAT_26

if ZMK_DISPLAY

config SPI
	default y

config IL0323
	bool
	default y

#config DISPLAY_WOB
#	bool "White on Black Display"
#	default n

choice LVGL_THEME_DEFAULT_FONT_NORMAL
    default LVGL_THEME_DEFAULT_FONT_NORMAL_MONTSERRAT_26

endchoice

choice LVGL_THEME_DEFAULT_FONT_SMALL
    default LVGL_THEME_DEFAULT_FONT_SMALL_MONTSERRAT_26

endchoice

config LVGL_HOR_RES_MAX
	default 80

config LVGL_VER_RES_MAX
	default 128

config LVGL_BITS_PER_PIXEL
	default 1

choice LVGL_COLOR_DEPTH
	default LVGL_COLOR_DEPTH_1

endchoice

config LVGL_DPI
	default 145

config LVGL_VDB_SIZE
	default 100

endif # ZMK_DISPLAY

# config CORNE_ISH_ZEN_20
#    bool

endif # BOARD_CORNEISH_ZEN_LEFT || BOARD_CORNEISH_ZEN_RIGHT
```
