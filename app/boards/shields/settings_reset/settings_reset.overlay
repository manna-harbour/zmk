/*
 * Copyright (c) 2020 The ZMK Contributors
 *
 * SPDX-License-Identifier: MIT
 */

#include <dt-bindings/zmk/matrix_transform.h>

/ {
        chosen {
                zmk,kscan = &kscan;
        };

        kscan: kscan {
                compatible = "zmk,kscan-mock";
                label = "KSCAN_MOCK";
                rows = <1>;
                columns = <1>;
                events = <>;
        };
};

